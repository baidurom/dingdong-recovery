;;;;;;;;;;;;;;;;;;;;;;;;;;;;;;;;;;;;;;;;;;;;;;;;;;;;;;;;
;;
;; Setup Android T32 debugging environment
;; Sample script
;;
;;;;;;;;;;;;;;;;;;;;;;;;;;;;;;;;;;;;;;;;;;;;;;;;;;;;;;;;

;; Declare local variables
ENTRY &AndroidRoot

local &kernelPath
local &T32Path

;; Break if already running
if run()
(
	break
)

;; Setup Windows
  winclear
  ; Display code listing
  WINPOS 0.0 0.0 68% 65% 12. 1. W000
  DATA.list

  ; Display register window
  WINPOS 68% 0. 32% 50% 0. 0. W002
  register /spotlight

  ; Display variables in HEX and with symbol names
  setup.var %open.on %hex

  ; Display stackframe with local variables
  WINPOS  68% 50% 32% 48% 0. 0. W003
  Var.Frame /Locals /Caller

;; Setup window area to display messages when setting this up
WINPOS 0% 65% 34% 35% 0. 0. W001
Area.create MAIN
Area.clear MAIN
Area.view MAIN
Area.select MAIN

print "   _   _  _ ___  ___  ___ ___ ___  "
print "  /_\ | \| |   \| _ \/ _ \_ _|   \ "
print " / _ \| .` | |) |   / (_) | || |) |"
print "/_/ \_\_|\_|___/|_|_\\___/___|___/ "
print " "
print "ANDROID root directory: &AndroidRoot"

&kernelPath="&AndroidRoot/kernel"
&T32LinuxScriptPath="c:/T32/demo/arm/kernel/linux"

; Generic start-up
Break.Delete		; remove any breakpoints
MAP.RESet		; reset debuggers memory mapping
MMU.RESet		; reset debuggers MMU
sYmbol.RESet		; remove any symbols

; Linux start-up
TrOnchip.Set DABORT OFF		; turn off breakpoint on data abort
TrOnchip.Set PABORT OFF		; turn off breakpoint on program abort
TrOnchip.Set UNDEF OFF		; turn off breakpoint on undefined instruction
SYStem.Option MMUSPACES ON	; enable space ids to virtual addresses

print "Loading Linux kernel symbols..."
data.load.elf "&AndroidRoot/out/target/product/msm7627a/obj/KERNEL_OBJ/vmlinux" /nocode /gnu

; Declare the MMU format to the debugger
 ; - table format is "LINUX"
 ; - table base address is at label "swapper_pg_dir"
 ; - kernel address translation
 ; Map the virtual kernel symbols to physical addresses to give
 ; the debugger access to it before CPU MMU is initialized

MMU.RESET
MMU.FORMAT LINUX swapper_pg_dir 0xC0000000--0xCfffffff 0x00200000
MMU.COMMON 0xC00000000--0xCFFFFFFF
MMU.AUTOSCAN ON
MMU.TABLEWALK ON
MMU.ON


; Configure Trace32 for Linux debugging
TASK.CONFIG "&T32LinuxScriptPath/linux.t32"		; Load Linux awareness
MENU.ReProgram "&T32LinuxScriptPath/linux.men"		; Load Linux menu
HELP.FILTER.Add rtoslinux				; Add linux awareness manual to help filter

TASK.sYmbol.Option MMUSCAN OFF				; not necessary with table walk

sYmbol.AutoLoad.CHECKLINUX "do &LinuxT32ScriptPath/autoload " 	; Switch on symbol autoloader

GROUP.Create "kernel" 0xC00000000--0xCFFFFFFFF /RED


; Configure Autoloader to automatically load symbols for process debugging
Task.SYMBOL.Option Autoload Process

; Display Linux processes
WINPOS  34% 65% 34% 35% 0. 0. W003
task.dtask
mode.hll

;; Setup break points in linux kernel to ease debugging
b.s \\vmlinux\panic\panic

&symbolPath="&AndroidRoot/out/target/product/msm7627a/symbols/system/lib"

;; The following addresses are based on prelink library map defined in
;; build/core/prelink-linux-arm.map.  Addresses may need to be customized
;; based on target

&libopencore_commonAddr=0xA3900000
&libopencore_playerAddr=0xA4800000
&libopencore_authorAddr=0xA5D00000
&libhardware_legacyAddr=0xA7E00000
&libhardwareAddr=0xA7F00000
&libaudioflingerAddr= 0xA8D00000
&libmediaAddr=0xA9000000
&libmediaplayerserviceAddr=0xA9200000
&libvorbisidecAddr=0xA9400000
&libsonivoxAddr=0xA9500000
&libaudioAddr=0xA9700000
&libaudiopolicyAddr=0xA9A00000
&libskiaAddr=0xAB100000
&libuiAddr=0xAB900000
&libEGLAddr=0xABE00000
&libGLESv1_CMAddr=0xAC200000
&libpixelflingerAddr=0xAC900000
&libdvmAddr=0xACA00000
&libandroid_runtimeAddr=0xAD300000
&liblogAddr=0xAFA00000
&libcAddr=0xAFD00000

;; Get the application ID
;&appsID=task.proc.spaceid("mediaserver");
;if &appsID==0xffffffff
;(
;    print "Error getting mediaserver ID.. exit"
;	enddo
;)
;print "ID"
;print &appsID

;; Load libraries
print "Loading Android library symbols..."
data.load.elf &symbolPath\libopencore_common.so &libopencore_commonAddr /gnu /nocode /noclear 
data.load.elf &symbolPath\libopencore_player.so &libopencore_playerAddr /gnu /nocode /noclear 
data.load.elf &symbolPath\libopencore_author.so &libopencore_authorAddr /gnu /nocode /noclear 
data.load.elf &symbolPath\libhardware.so &libhardwareAddr /gnu /nocode /noclear 
data.load.elf &symbolPath\libaudioflinger.so &libaudioflingerAddr /gnu /nocode /noclear 
data.load.elf &symbolPath\libmedia.so &libmediaAddr /gnu /nocode /noclear 
data.load.elf &symbolPath\libmediaplayerservice.so &libmediaplayerserviceAddr /gnu /nocode /noclear 
data.load.elf &symbolPath\libvorbisidec.so &libvorbisidecAddr /gnu /nocode /noclear 
data.load.elf &symbolPath\libsonivox.so &libsonivoxAddr /gnu /nocode /noclear 
data.load.elf &symbolPath\libaudio.so &libaudioAddr /gnu /nocode /noclear 
data.load.elf &symbolPath\libaudiopolicy.so &libaudiopolicyAddr /gnu /nocode /noclear 
data.load.elf &symbolPath\libskia.so &libskiaAddr /gnu /nocode /noclear 
data.load.elf &symbolPath\libui.so &libuiAddr /gnu /nocode /noclear 
data.load.elf &symbolPath\libEGL.so &libEGLAddr /gnu /nocode /noclear 
data.load.elf &symbolPath\libGLESv1_CM.so &libGLESv1_CMAddr /gnu /nocode /noclear 
data.load.elf &symbolPath\libpixelflinger.so &libpixelflingerAddr /gnu /nocode /noclear 
data.load.elf &symbolPath\libdvm.so &libdvmAddr /gnu /nocode /noclear 
data.load.elf &symbolPath\libandroid_runtime.so &libandroid_runtimeAddr /gnu /nocode /noclear 
data.load.elf &symbolPath\liblog.so &liblogAddr /gnu /nocode /noclear 
data.load.elf &symbolPath\libc.so &libcAddr /gnu /nocode /noclear 


;Source Paths for libraries
print "Adding default source paths..."
y.spath.srd "&AndroidRoot/kernel"
y.spath.srd "&AndroidRoot/hardware/msm7k"
y.spath.srd "&AndroidRoot/frameworks/base"
y.spath.srd "&AndroidRoot/system/core"

print "Done."
ENDDO
