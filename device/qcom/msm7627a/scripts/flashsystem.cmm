
do setup.cmm

if ("&SYSTEM_IMG"!="")
(
  do flash system &SYSTEM_IMG
)
