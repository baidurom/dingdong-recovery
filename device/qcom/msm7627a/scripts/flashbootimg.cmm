
do setup.cmm

local &addr
local &size
local &pagesize
local &hdr

sys.down
sys.cpu arm1136j
sys.jtagclock rtck
sys.mode attach
if state.run() 
  break

&pagesize=0x800
&hdr=&SYSTEM_HDR_ADDR

; 000 magic
; 008 kernel_size
; 00c kernel_addr
; 010 ramdisk_size
; 014 ramdisk_addr
; 018 second_size
; 01c second_addr
; 020 tags_addr
; 024 page_size
; 028 unused0/1
; 030 unused2/3/4/5
; 040 cmdline

; fill boot image header with 0s initially
;
d.s &hdr++&pagesize %byte 0
;d.s &hdr++0x300000 %long 0

d.s &hdr+0x000 "ANDROID!"
d.s &hdr+0x00c %long &KERNEL_ADDR
d.s &hdr+0x014 %long &RAMDISK_ADDR
if ("&SECOND_STAGE"!="")
(
   d.s &hdr+0x01c %long &SECOND_STAGE_ADDR
)
d.s &hdr+0x020 %long &TAGS_ADDR
d.s &hdr+0x024 %long &pagesize
d.s &hdr+0x040 "&CMDLINE"

; advance to the kernel slot
;
&addr=&hdr+&pagesize

; load the kernel image
;
if y.exist("\\flashimg")
  symbol.delete \\flashimg
data.load.binary &KERNEL &addr /name flashimg /noclear
&size=y.sizeof("\\flashimg")

d.s &hdr+0x008 %long &size

; advance addr to next page-aligned region > &size
;
&addr=&addr+((&size+(&pagesize-1))&(~(&pagesize-1)))

; load the ramdisk image
;
if y.exist("\\flashimg")
  symbol.delete \\flashimg
data.load.binary &RAMDISK &addr /name flashimg /noclear
&size=y.sizeof("\\flashimg")

d.s &hdr+0x010 %long &size

&addr=&addr+((&size+(&pagesize-1))&(~(&pagesize-1)))

if ("&SECOND_STAGE"!="")
(
  if ("&SECOND_STAGE"=="wait")
  (
    d.s &addr %long 0xeafffffe
    &size= 4
  )
  else if ("&SECOND_STAGE"=="fixup")
  (
    local &ip
    &ip= &addr
    ;gosub emit b &addr
    gosub emit mov r1, #&MACHINE_ID
    gosub emit mov r4, #0
    gosub emit str r4, [r2, #0xd0] ; terminate tags

    ; change kernel commandline
    gosub emit mov r4, #0
    gosub emit strb r4, [r2, #0x28] ; no console
    ;gosub emit strb r4, [r2, #0x35] ; tty1 only
    ;gosub emit strb r4, [r2, #0x45] ; tty1 + ttyMSM0 only

    ;gosub emit b &ip
    gosub emit mov r4, #0x98000000 ; CPLD base
    gosub emit ldrb r5, [r4, #0x0a] ; INT2
    gosub emit tst r5, #0x10 ; NAVI_ACT#
    gosub emit beq &ip-8
    gosub emit tst r5, #2 ; NAVI_DOWN#
    gosub emit moveq r5, #0xab
    gosub emit streqb r5, [r4, #0x00] ; MISC1
    gosub emit beq &ip
    ;gosub emit b &ip
    gosub emit mov r4, #(&KERNEL_ADDR&0xff000000)
    gosub emit add r4, r4, #(&KERNEL_ADDR&0x00ff0000)
    gosub emit add r4, r4, #(&KERNEL_ADDR&0x0000ff00)
    gosub emit add pc, r4, #(&KERNEL_ADDR&0x000000ff)
    &size= &ip-&addr
  )
  else
  (
    ; load the second stage image
    ;
    if y.exist("\\flashimg")
      symbol.delete \\flashimg
    data.load.binary &SECOND_STAGE &addr /name flashimg /noclear
    &size=y.sizeof("\\flashimg")
  )
  
  d.s &hdr+0x018 %long &size
  
  &addr=&addr+((&size+(&pagesize-1))&(~(&pagesize-1)))
)

do flash boot MEMORY (&addr-&hdr)
;do flash recovery MEMORY (&addr-&hdr)

enddo

emit:
    ENTRY &op1 &op2 &op3 &op4 &op5
    d.a &ip &op1 &op2 &op3 &op4 &op5
    &ip=&ip+4
    RETURN

