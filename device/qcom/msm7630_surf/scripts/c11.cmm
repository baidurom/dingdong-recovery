; MSM7200 ARM11 in JTAG Chained Mode

system.option.TRST ON
system.option.CFLUSH ON
system.option.ResBreak ON
system.option.EnReset ON
system.option.WaitReset ON
system.jtagclock RTCK

sys.cpu arm1136j
system.multicore irpre 0.
system.multicore drpre 0.
system.multicore irpost 4.
system.multicore drpost 1.
sys.mode attach
