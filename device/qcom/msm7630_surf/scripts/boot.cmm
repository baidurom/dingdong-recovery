
sys.cpu arm1136j
sys.jtagclock rtck
sys.mode attach
if state.run()
(
  break
)

do setup

data.load.elf "&(OUT)obj/EXECUTABLES/bootloader_intermediates/bootloader.elf" /relpath /path ../boot/

tronchip.set dabort off
tronchip.set pabort off

term.reset
term.size 50 100
term.scroll.on
term

go
