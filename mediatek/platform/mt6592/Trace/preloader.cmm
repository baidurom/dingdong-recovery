SYSTEM.RESET
SYSTEM.OPTION ENRESET ON
SYSTEM.OPTION RESBREAK OFF

SYSTEM.JTAGCLOCK 10.MHz

SYSTEM.CPU CortexA7MPCore

;R-T Memory Access
SYSTEM.MULTICORE MEMORYACCESSPORT 0
SYSTEM.MULTICORE DEBUGACCESSPORT 1

;Setting Core debug register access
SYSTEM.MULTICORE COREBASE APB:0x80070000
SYStem.Up
wait 200.us

  
D.S SD:0x10200000 %LE %LONG 0x00000020  ;L2C share SRAM


; set_hw_breakpoint_by_def
; setting attribute of breakpoints
Break.Select Program OnChip
Break.Select Hll OnChip
Break.Select Spot OnChip
Break.Select Read OnChip
Break.Select Write OnChip

D.S C15:0x1 0				; Turn off MMU

; disable wdt (debug purpose)
D.S SD:0x10000500 %LE %LONG 0x22000000

; board init
print "loading pre-loader image"

D.LOAD.ELF      ../../../../mediatek/preloader/bin/preloader.elf 

Y.SPATH.RESET ; reset all source path
Y.SPATH.SRD ../../../../mediatek/platform/mt6592/preloader/src/init
Y.SPATH.SRD ../../../../mediatek/platform/mt6592/preloader/src/core
Y.SPATH.SRD ../../../../mediatek/platform/mt6592/preloader/src/drivers
Y.SPATH.SRD ../../../../mediatek/platform/mt6592/preloader/src/security
Y.SPATH.SRD ../../../../mediatek/custom/mt6592_fpga_emmc/preloader
Y.SPATH.SRD ../../../../mediatek/protect-private/security/ASF/preloader

Break.Select Program OnChip
Break.Select Hll OnChip
Break.Select Spot OnChip
Break.Select Read OnChip
Break.Select Write OnChip

R.S T 0
;winclear
d.l
enddo








