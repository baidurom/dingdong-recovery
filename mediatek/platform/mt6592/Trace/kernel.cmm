do project.cmm
; =========================================
; Please DO NOT modify this section - START
; =========================================
;SYSTEM.Reset
&ICE=2
&NR_CPUS=8
&USE_SERIAL_WIRE_DEBUG=0

if version.build()==0x100000
(
    ; CVD
    &ICE=2
)
else
(
    ; TRACE32
    &ICE=1
)
SYStem.CPU CortexA7MPCore

System.Option Cflush on    	;flush the cache to avoid data consistency
SYSTEM.OPTION ENRESET On
SYSTEM.OPTION TRST On
SYStem.Option ResBreak OFF
SYStem.Option WaitReset OFF
SYStem.JtagClock 10MHz
; Set up serial wire config
if &USE_SERIAL_WIRE_DEBUG==1
(
	System.CONFIG SWDP ON
)
else
(
    System.CONFIG SWDP OFF
)

;R-T Memory Access
SYSTEM.MULTICORE MEMORYACCESSPORT 0
SYSTEM.MULTICORE DEBUGACCESSPORT 1

;Setting Core debug register access
SYSTEM.CONFIG CORENUMBER &NR_CPUS
if &ICE==1
(
    if &NR_CPUS==2
    (
        core.assign 1 2
    )
    else
    (
        if &NR_CPUS==4
        (
            core.assign 1 2 3 4
        )
        else
        (
            core.assign 1 2 3 4 5 6 7 8
        )
    )
)
;Setting Core debug register access
if &NR_CPUS==2
(
    SYSTEM.CONFIG COREBASE 0x80070000 0x80072000
)
else
(
    if &NR_CPUS==4
    (
        SYSTEM.CONFIG COREBASE 0x80070000 0x80072000 0x80074000 0x80076000
    )
    else
    (
        SYSTEM.CONFIG COREBASE 0x80070000 0x80072000 0x80074000 0x80076000 0x80090000 0x80092000 0x80094000 0x80096000
    )
)

sys.mode go
wait 500.ms
sys.mode down
wait 100.ms
sys.mode up
;SYStem.Up

;Register.REset

SETUP.IMASKASM	ON          ; Disbale interrupt during assembly step
SETUP.IMASKHLL	ON          ; Disbale interrupt during C step

;D.S C15:0x1 0				; Turn off MMU

do wdt.cmm  ; disable hw watchdog timer

Break.SELect Program OnChip ; set_hw_breakpoint_by_def   Jau add
;Break.SELect Hll OnChip     ; setting attribute of breakpoints
;Break.SELect Spot OnChip
Break.SELect Read OnChip
Break.SELect Write OnChip

;print "loading mt6592 pre-loader"
;
;D.LOAD.ELF ../../../../mediatek/preloader/bin/preloader_&project.elf /nocode
;
;Y.SPATH.RESET ; reset all source path
;Y.SPATH.SRD 
;Y.SPATH.SRD ../../../../mediatek/platform/mt6592/preloader/src/init
;Y.SPATH.SRD ../../../../mediatek/platform/mt6592/preloader/src/drivers
;Y.SPATH.SRD ../../../../mediatek/platform/mt6592/preloader/src/security
;Y.SPATH.SRD ../../../../mediatek/platform/mt6592/preloader/src/core
;Y.SPATH.SRD ../../../../mediatek/custom/&project/preloader
;Y.SPATH.SRD ../../../../mediatek/platform/mt6592/preloader
;
;;go JumpCmd /Onchip
;;wait !run()
;
;Break.Delete 
;B.set jump
;go
;wait !run()
;***************************************************************************************************
print "load linx kernel image"

Break.Delete 
sYmbol.RESet

 TrOnchip.Set DABORT OFF        ; used by Linux for page miss!
 TrOnchip.Set SWI OFF        
 TrOnchip.Set PABORT OFF        ; used by Linux for page miss!
 TrOnchip.Set UNDEF OFF         ; used to detect non-existent coprocessor
 SYStem.Option MMU ON           ; enable space ids to virtual addresses


;;disbale interrupt during assembly step
;SETUP.IMASKASM	ON
;;disbale interrupt during C step
;SETUP.IMASKHLL	ON

;; turn off mmu
;d.s c15:0x1 0

print "loading Linux kernel symbols..."


Y.SPATH.RESET ; reset all source path
Y.SPATH.SRD ../../../../mediatek/platform/mt6592/kernel
Y.SPATH.SRD ../../../../mediatek/kernel
Y.SPATH.SRD ../../../../mediatek/custom/out/&project/kernel
Y.SPATH.SRD ../../../../kernel/out/init
Y.SPATH.SRD ../../../../kernel/out/drivers/
Y.SPATH.SRD ../../../../kernel/out/include
Y.SPATH.SRD ../../../../kernel/out/lib
Y.SPATH.SRD ../../../../kernel/out/fs/fat
Y.SPATH.SRD ../../../../kernel/out/tools

Data.LOAD.Elf ../../../../kernel/out/vmlinux /gnu /nocode

;go start_kernel /Onchip
;wait !run()
B.set start_kernel
d.l
go

print "load kernel symbols down....."

task.config Linux
menu.reprogram  Linux
menu.reprogram watchdog

B::
TOOLBAR ON
STTUSBAR ON
;WINPAGE.RESET

WINPOS 0.125 0.125 100. 30. 13. 1. W000
WINTABS 16. 10. 25. 62.
;WINPAGE.SELECT P000

on pbreak gosub
(
	 ;AP WDT disable
	 d.s asd:0x10000500 %le %long 0x22000000

)

stop
end



